## conf/layer.conf
```bitbake
# We have a conf and classes directory, add to BBPATH
BBPATH .= ":${LAYERDIR}"

# We have recipes-* directories, add to BBFILES
BBFILES += "${LAYERDIR}/recipes-*/*/*.bb \
            ${LAYERDIR}/recipes-*/*/*.bbappend"

BBFILE_COLLECTIONS += "meta-modberry"
BBFILE_PATTERN_meta-modberry = "^${LAYERDIR}/"
BBFILE_PRIORITY_meta-modberry = "11"

LAYERDEPENDS_meta-modberry = "core"
LAYERSERIES_COMPAT_meta-modberry = "kirkstone"
```

## conf/machine/modberry-m40804w-max-basic.conf
```bitbake
#@TYPE: Machine
#@NAME: Modberry with RPi CM4 (64-bit) by Bynacon
#@DESCRIPTION: This is a basic image for Modberry based on RPi CM4 in 64-bit.

include conf/machine/modberry-m40804w-max.conf
BBMASK = " \
    meta-ota/ \
    meta-edgecon/ \
    meta-mender/ \
"
```

## conf/machine/modberry-m40804w-max-ota.conf
```bitbake
#@TYPE: Machine
#@NAME: Modberry with RPi CM4 (64-bit) by Bynacon
#@DESCRIPTION: This is an OTA image for Modberry based on RPi CM4 in 64-bit but you need the private meta-ota of bynacon or create your own meta-ota for mender-ota.
include conf/machine/modberry-m40804w-max.conf
BBMASK = " \
    meta-edgecon/ \
"

###############################################################################
### Mender configuration
###############################################################################

PREFERRED_PROVIDER_u-boot-fw-utils = "libubootenv"

PREFERRED_VERSION_mender-client = "3.3.0"
PREFERRED_VERSION_mender-artifact = "3.8.0"
PREFERRED_VERSION_mender-artifact-native = "3.8.0"
PREFERRED_VERSION_mender-connect = "2.0.1"

MENDER_UBOOT_STORAGE_INTERFACE = "mmc"
MENDER_UBOOT_STORAGE_DEVICE = "0"

MENDER_DTB_NAME= "broadcom/bcm2711-rpi-cm4.dtb"

MENDER_UBOOT_ENV_STORAGE_DEVICE_OFFSET_1 = "0x400000" 
MENDER_UBOOT_ENV_STORAGE_DEVICE_OFFSET_2 = "0x800000"

MENDER_PARTITION_ALIGNMENT = "4194304"

MENDER_UPDATE_POLL_INTERVAL_SECONDS = "5"
MENDER_INVENTORY_POLL_INTERVAL_SECONDS = "5"
MENDER_RETRY_POLL_INTERVAL_SECONDS = "30"

INHERIT += "mender-full"

MENDER_FEATURES_ENABLE:append = " mender-uboot mender-image-sd"
MENDER_FEATURES_DISABLE:append = " mender-grub mender-image-uefi"

MENDER_BOOT_PART_SIZE_MB = "64"
MENDER_STORAGE_TOTAL_SIZE_MB = "6144"
ARTIFACTIMG_FSTYPE = "ext4"

IMAGE_INSTALL:append = " mender-connect"

### Update Raspberry Pi firmware files ###
#INHERIT += "rpi-update-firmware"
```

## conf/machine/modberry-m40804w-max.conf
```bitbake
#@TYPE: Machine
#@NAME: Modberry with RPi CM4 (64-bit) by Bynacon
#@DESCRIPTION: This is the basic machine configuration of Modberry based on RPi CM4 in 64-bit. You need the modberry-m40804w-max-basic.conf machine configuration for a simple image. If you want an OTA image, you need the modberry-m40804w-max-ota.conf machine configuration.

include conf/machine/raspberrypi4-64.conf

#VC4DTBO:remove ?= "vc4-kms-v3d"

###############################################################################
### Hardware
###############################################################################

RPI_USE_U_BOOT = "1"

IMAGE_INSTALL:append = " \
    kernel-image \ 
    kernel-devicetree \
    kernel-modules \
    rpi-gpio \
    raspi-gpio \
    usbutils \
    pciutils \
"

ENABLE_DWC2_HOST = "1"
ENABLE_DWC2_PERIPHERAL = "1"

RPI_KERNEL_DEVICETREE_OVERLAYS:append = " overlays/miniuart-bt.dtbo"

### UART ###
ENABLE_UART = "1"

### I2C ###
###############################################################################
ENABLE_I2C = "1"
CHANGE_I2C_BAUDRATE = "400000"
KERNEL_MODULE_AUTOLOAD:rpi += " i2c-dev i2c-bcm2708"
IMAGE_INSTALL:append = " i2c-tools"

RPI_KERNEL_DEVICETREE_OVERLAYS:append = " overlays/i2c0.dtbo"
ENABLE_I2C0_PINS_44_45 = "1"
RPI_KERNEL_DEVICETREE_OVERLAYS:append = " overlays/i2c1.dtbo"
ENABLE_I2C1_PINS_0_1 = "1"

###########
### I2C0
###########

### 1-wire DS2482S-100+ (address 0x18 / IRQ LINE GPIO5) ###
#RPI_KERNEL_DEVICETREE_OVERLAYS:append = " overlays/xxxx.dtbo"

### DIDO MCP23008 (address 0x20 / IRQ LINE GPIO6) ### => INFO: Configure directly at machine-dtb
#RPI_KERNEL_DEVICETREE_OVERLAYS:append = " overlays/mcp23017.dtbo"
 
### Function MCP23008 (address 0x21) ### => INFO: Configure directly at machine-dtb
#RPI_KERNEL_DEVICETREE_OVERLAYS:append = " overlays/mcp23008-function.dtbo"

### RS485/232 SC16IS740 (address 0x4d / IRQ LINE GPIO16) ### => INFO: Configure directly at machine-dtb
#RPI_KERNEL_DEVICETREE_OVERLAYS:append = " overlays/sc16is740-serial.dtbo"

### EEPROM AT24CS01-STUM (address 0x50) ###
#RPI_KERNEL_DEVICETREE_OVERLAYS:append = " overlays/xxxx.dtbo"

### AI MCP3424 (address 0x6C) ###
#RPI_KERNEL_DEVICETREE_OVERLAYS:append = " overlays/xxxx.dtbo"

### RTC	MCP79412 (address 0x6f) ###
RPI_KERNEL_DEVICETREE_OVERLAYS:append = " overlays/mcp7941x-rtc.dtbo"
#NOTE - MACHINE_FEATURES and more at "Timezone & RTC" in local_kirkstone.conf


### SPI ###
###############################################################################
ENABLE_SPI_BUS = "1"
KERNEL_MODULE_AUTOLOAD:rpi += " spidev"
IMAGE_INSTALL:append = " \
    spitools \
    kernel-module-spidev \
    kernel-module-spi-bcm2835 \
    "

RPI_KERNEL_DEVICETREE_OVERLAYS:append = " overlays/spi0-2cs.dtbo"

###########
### SPI0
###########

### TPM ###
### SLB9670 (Chipselect GPIO7 CS0 / IRQ LINE GPIO5) ###
RPI_KERNEL_DEVICETREE_OVERLAYS:append = " overlays/slb9670-tpm.dtbo"

IMAGE_INSTALL:append = " \
    tpm2-tools \
    libtss2 \
    libtss2-tcti-device \
    libtss2-tcti-mssim \
    tpm2-abrmd \ 
    tpm2-pkcs11 \ 
    slb9670 \
"
#NOTE - MACHINE_FEATURES and more at "TPM" in local_kirkstone.conf


### CAN ###
### MCP2515 (Chipselect GPIO8 CS1 / IRQ LINE GPIO12) ###
RPI_KERNEL_DEVICETREE_OVERLAYS:append = " overlays/mcp2515-can.dtbo"

### config.txt ###
###############################################################################
ENABLE_modberry-m40804w-max-m = "1"

DISTRO_FEATURES:append = " bluez5 bluetooth "

IMAGE_INSTALL:append = " bluez5  "

IMAGE_INSTALL:append = " \
    linux-firmware-rpidistro-bcm43455 \
    iw \
    crda \
    bridge-utils \
    hostapd \
    hostapddeamon \
    dhcpcd \
    iptables \
    dnsmasq \
    ifplugd \
    init-ifupdown \
"

### Network ###
IMAGE_INSTALL:append = " \
    udev \
    udev-wlan \
"

###############################################################################
### Splash / Psplash
###############################################################################

IMAGE_FEATURES:remove = " splash"
IMAGE_FEATURE:remove = " psplash"

###############################################################################
### Testing
###############################################################################

IMAGE_INSTALL:append = " \
    mbus \
"
```
