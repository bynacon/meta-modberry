// Definitions for several I2C based sc16is752
// Available through i2c-gpio
/dts-v1/;
/plugin/;

/ {
	compatible = "brcm,bcm2835";

	fragment@0 {
		target-path = "/";
		__overlay__ {
			i2c_gpio: sc16is752-gpio-i2c@0 {
				compatible = "i2c-gpio";
				gpios = <   &gpio 23 0 /* sda */
					        &gpio 24 0 /* scl */
					>;
				i2c-gpio,delay-us = <2>;        /* ~100 kHz */
				#address-cells = <1>;
				#size-cells = <0>;
			};
		};
	};

    fragment@1 {
		target = <&i2c_gpio>;
		__overlay__ {
			#address-cells = <1>;
			#size-cells = <0>;
			status = "okay";

			sc16is752: sc16is752@48 {
				compatible = "nxp,sc16is752";
				reg = <0x48>; /* i2c address */
				clocks = <&sc16is752_clk>;
				interrupt-parent = <&gpio>;
				interrupts = <26 2>; /* IRQ_TYPE_EDGE_FALLING */
				gpio-controller;
				#gpio-cells = <2>;
				i2c-max-frequency = <400000>;
			};
		};
	};

	fragment@2 {
		target-path = "/";
		__overlay__ {
			sc16is752_clk: sc16is752_i2c_clk@48 {
				compatible = "fixed-clock";
				#clock-cells = <0>;
				clock-frequency = <14745600>;
			};
		};
	};

	__overrides__ {
		i2c_gpio_sda = <&i2c_gpio>,"gpios:4";
		i2c_gpio_scl = <&i2c_gpio>,"gpios:16";
		i2c_gpio_delay_us = <&i2c_gpio>,"i2c-gpio,delay-us:0";
       		int_pin = <&sc16is752>,"interrupts:0";
        	addr = <&sc16is752>,"reg:0",<&sc16is752_clk>,"name";
        	xtal = <&sc16is752_clk>,"clock-frequency:0";
	};
};
